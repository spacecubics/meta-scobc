/ {
	emmc_vcc: regulator-emmc-vcc {
		compatible = "regulator-fixed";
		regulator-name = "emmc-vcc";
		regulator-min-microvolt = <3300000>;
		regulator-max-microvolt = <3300000>;
		gpio = <&gpio1 51 0>;
		enable-active-high;
		regulator-boot-on;
		startup-delay-us = <100000>;
		off-on-delay-us = <500000>;
	};
};

&sdhci1 {
	vmmc-supply = <&emmc_vcc>;
};

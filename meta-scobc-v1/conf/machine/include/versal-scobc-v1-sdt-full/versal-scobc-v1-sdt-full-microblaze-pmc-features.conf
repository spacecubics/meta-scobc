## meta-scobc-v1/conf/machine/include/versal-scobc-v1-sdt-full/versal-scobc-v1-sdt-full-microblaze-pmc-features.conf
```bitbake
MACHINE_FEATURES = "cframe cfupmc common csudma emacps gpiops iomodule ipipsu qspipsu sdps spips sysmonpsv trngpsv ttcps uartlite uartpsv usbpsu zdma"
```

## meta-scobc-v1/conf/machine/versal-scobc-v1-ve2302e-xsct-full.conf
```bitbake
#@TYPE: Machine
#@NAME: versal-scobc-v1-ve2302e-xsct-full
#@DESCRIPTION: Machine configuration for the versal-scobc-v1-ve2302e-xsct-full boards.

#### Preamble
MACHINEOVERRIDES =. "${@['', 'versal-scobc-v1-ve2302e-xsct-full:']['versal-scobc-v1-ve2302e-xsct-full' !='${MACHINE}']}"
#### Regular settings follow

# Yocto device-tree variables
YAML_CONSOLE_DEVICE_CONFIG:pn-device-tree ?= "versal_ps_pspmc_0_psv_sbsauart_0"
YAML_MAIN_MEMORY_CONFIG:pn-device-tree ?= "versal_noc_C0_DDR_LOW0"
DT_PADDING_SIZE:pn-device-tree ?= "0x1000"
DTC_FLAGS:pn-device-tree ?= ""
YAML_DT_BOARD_FLAGS ?= "{BOARD template}"

# Yocto u-boot-xlnx variables
UBOOT_MACHINE ?= "xilinx_versal_virt_defconfig"

# Yocto PLM variables
YAML_SERIAL_CONSOLE_STDIN:pn-plm-firmware ?= "versal_ps_pspmc_0_psv_sbsauart_0"
YAML_SERIAL_CONSOLE_STDOUT:pn-plm-firmware ?= "versal_ps_pspmc_0_psv_sbsauart_0"

# Serial Console Settings
SERIAL_CONSOLES ?= "115200;ttyAMA0"
YAML_SERIAL_CONSOLE_BAUDRATE ?= "115200"

# Yocto arm-trusted-firmware(TF-A) variables
TFA_CONSOLE ?= "pl011"
TFA_BL33_LOAD ?= "0x8000000"

# Set DDR Base address for u-boot-xlnx-scr variables
DDR_BASEADDR ?= "0x0"
SKIP_APPEND_BASEADDR ?= "0"

# Yocto KERNEL Variables
UBOOT_ENTRYPOINT  ?= "0x200000"
UBOOT_LOADADDRESS ?= "0x200000"

# Yocto MACHINE_FEATURES Variable
MACHINE_FEATURES += "vdu"

# Required generic machine inclusion
require conf/machine/versal-generic.conf

# This is an 'XSCT' based BSP
XILINX_XSCT_VERSION = "2025.1"
XILINX_WITH_ESW = "xsct"

# Add system XSA
HDF_URI = "file://${SCOBC_HDF_DIR}/versal-scobc-v1-ve2302e.xsa"
HDF_URI[sha256sum] = "cc64bfe2a033a3639b20eabfdc4c043a7c7a64e0fc0d5639e4992ba2eb0d1d44"

#### No additional settings should be after the Postamble
#### Postamble
PACKAGE_EXTRA_ARCHS:append = "${@['', ' versal_scobc_v1_ve2302e_xsct_full']['versal-scobc-v1-ve2302e-xsct-full' != '${MACHINE}']}"
```

## meta-scobc/conf/layer.conf
```bitbake
# We have a conf and classes directory, add to BBPATH
BBPATH .= ":${LAYERDIR}"

# We have recipes-* directories, add to BBFILES
BBFILES += "${LAYERDIR}/recipes-*/*/*.bb \
            ${LAYERDIR}/recipes-*/*/*.bbappend"

BBFILE_COLLECTIONS += "scobc"
BBFILE_PATTERN_scobc = "^${LAYERDIR}/"
BBFILE_PRIORITY_scobc = "6"

LAYERDEPENDS_scobc = "core"
LAYERSERIES_COMPAT_scobc = "scarthgap"

SCOBC_HDF_DIR = "${LAYERDIR}/recipes-bsp/hdf/files"
SCOBC_SDT_DIR = "${LAYERDIR}/recipes-bsp/sdt/files"
```

## meta-scobc/conf/machine/versal-scobc-v1-ve2302i-xsct-full.conf
```bitbake
#@TYPE: Machine
#@NAME: versal-scobc-v1-ve2302i-xsct-full
#@DESCRIPTION: Machine configuration for the versal-scobc-v1-ve2302i-xsct-full boards.

#### Preamble
MACHINEOVERRIDES =. "${@['', 'versal-scobc-v1-ve2302i-xsct-full:']['versal-scobc-v1-ve2302i-xsct-full' !='${MACHINE}']}"
#### Regular settings follow

# Yocto device-tree variables
YAML_CONSOLE_DEVICE_CONFIG:pn-device-tree ?= "versal_ps_pspmc_0_psv_sbsauart_0"
YAML_MAIN_MEMORY_CONFIG:pn-device-tree ?= "versal_noc_C0_DDR_LOW0"
DT_PADDING_SIZE:pn-device-tree ?= "0x1000"
DTC_FLAGS:pn-device-tree ?= ""
YAML_DT_BOARD_FLAGS ?= "{BOARD template}"

# Yocto u-boot-xlnx variables
UBOOT_MACHINE ?= "xilinx_versal_virt_defconfig"

# Yocto PLM variables
YAML_SERIAL_CONSOLE_STDIN:pn-plm-firmware ?= "versal_ps_pspmc_0_psv_sbsauart_0"
YAML_SERIAL_CONSOLE_STDOUT:pn-plm-firmware ?= "versal_ps_pspmc_0_psv_sbsauart_0"

# Serial Console Settings
SERIAL_CONSOLES ?= "115200;ttyAMA0"
YAML_SERIAL_CONSOLE_BAUDRATE ?= "115200"

# Yocto arm-trusted-firmware(TF-A) variables
TFA_CONSOLE ?= "pl011"
TFA_BL33_LOAD ?= "0x8000000"

# Set DDR Base address for u-boot-xlnx-scr variables
DDR_BASEADDR ?= "0x0"
SKIP_APPEND_BASEADDR ?= "0"

# Yocto KERNEL Variables
UBOOT_ENTRYPOINT  ?= "0x200000"
UBOOT_LOADADDRESS ?= "0x200000"

# Yocto MACHINE_FEATURES Variable
MACHINE_FEATURES += "vdu"

# Required generic machine inclusion
require conf/machine/versal-generic.conf

# This is an 'XSCT' based BSP
XILINX_XSCT_VERSION = "2025.1"
XILINX_WITH_ESW = "xsct"

# Add system XSA
HDF_URI = "file://${SCOBC_HDF_DIR}/versal-scobc-v1-ve2302i.xsa"
HDF_URI[sha256sum] = "52e8ca1b8308ae3a9b4118ce1b46e7cec966bb1834d8356b002451a1d991b259"

#### No additional settings should be after the Postamble
#### Postamble
PACKAGE_EXTRA_ARCHS:append = "${@['', ' versal_scobc_v1_ve2302i_xsct_full']['versal-scobc-v1-ve2302i-xsct-full' != '${MACHINE}']}"
```

## meta-scobc/wic/sc-container-sd.wks
```
# Description: Creates a partitioned SD card image for container-enabled
# development and testing. Boot files are placed in the first VFAT
# partition. The root filesystem is placed in the second EXT4 partition.
#
# This wks is based on the Xilinx default SD card layout, but increases
# the root partition size to 2 GiB. The larger root partition provides
# additional free space on the target system for Podman container images,
# writable layers, temporary files, and package installation.
part  /boot  --source rootfs --change-directory=boot  --fixed-size=512M  --fstype=vfat  --use-label  --label boot  --active  --align 4
part  /      --source rootfs --exclude-path=boot/     --fixed-size=2G    --fstype=ext4  --use-label  --label root            --align 4
```
